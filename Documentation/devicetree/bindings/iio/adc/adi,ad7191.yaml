## Documentation/devicetree/bindings/iio/adc/adi,ad7191.yaml
```yaml
# SPDX-License-Identifier: (GPL-2.0 OR BSD-2-Clause)
# Copyright 2025 Analog Devices Inc.
%YAML 1.2
---
$id: http://devicetree.org/schemas/iio/adc/adi,ad7191.yaml#
$schema: http://devicetree.org/meta-schemas/core.yaml#

title: Analog Devices AD7191 ADC device driver

maintainers:
  - Alisa-Dariana Roman <alisa.roman@analog.com>

description: |
  Bindings for the Analog Devices AD7191 ADC device. Datasheet can be
  found here:
  https://www.analog.com/media/en/technical-documentation/data-sheets/AD7191.pdf

properties:
  compatible:
    enum:
      - adi,ad7191

  reg:
    maxItems: 1

  spi-cpol: true

  spi-cpha: true

  clocks:
    maxItems: 1
    description:
      Optionally, either a crystal can be attached externally between MCLK1 and
      MCLK2 pins, or an external CMOS-compatible clock can drive the MCLK2
      pin. If absent, internal 4.92MHz clock is used.

  interrupts:
    maxItems: 1

  avdd-supply:
    description: AVdd voltage supply

  dvdd-supply:
    description: DVdd voltage supply

  vref-supply:
    description: Vref voltage supply

  odr-gpios:
    description: |
      ODR1 and ODR2 pins for output data rate selection. Should be defined if
      adi,odr-state is absent.
    maxItems: 2

  adi,odr-state:
    $ref: /schemas/types.yaml#/definitions/uint32
    description: |
      Should be present if ODR pins are pin-strapped. Value corresponds to:
      0: 120 Hz (ODR1=0, ODR2=0)
      1: 60 Hz (ODR1=0, ODR2=1)
      2: 50 Hz (ODR1=1, ODR2=0)
      3: 10 Hz (ODR1=1, ODR2=1)
      If defined, odr-gpios must be absent.
    enum: [0, 1, 2, 3]

  pga-gpios:
    description: |
      PGA1 and PGA2 pins for gain selection. Should be defined if adi,pga-state
      is absent.
    maxItems: 2

  adi,pga-state:
    $ref: /schemas/types.yaml#/definitions/uint32
    description: |
      Should be present if PGA pins are pin-strapped. Value corresponds to:
      0: Gain 1 (PGA1=0, PGA2=0)
      1: Gain 8 (PGA1=0, PGA2=1)
      2: Gain 64 (PGA1=1, PGA2=0)
      3: Gain 128 (PGA1=1, PGA2=1)
      If defined, pga-gpios must be absent.
    enum: [0, 1, 2, 3]

  temp-gpios:
    description: TEMP pin for temperature sensor enable.
    maxItems: 1

  chan-gpios:
    description: CHAN pin for input channel selection.
    maxItems: 1

  clksel-gpios:
    description: |
      Clock source selection pin (internal or external). Should be defined if
      clksel-config is absent.
    maxItems: 1

  adi,clksel-state:
    $ref: /schemas/types.yaml#/definitions/uint32
    description: |
      Should be present if CLKSEL is pin-strapped. 0 selects an external clock,
      1 selects the internal clock. If defined, clksel-gpios must be absent.
    enum: [0, 1]

required:
  - compatible
  - reg
  - interrupts
  - avdd-supply
  - dvdd-supply
  - vref-supply
  - spi-cpol
  - spi-cpha
  - temp-gpios
  - chan-gpios

allOf:
  - $ref: /schemas/spi/spi-peripheral-props.yaml#
  - if:
      required:
        - adi,odr-state
    then:
      properties:
        odr-gpios: false
    else:
      required:
        - odr-gpios
  - if:
      required:
        - adi,pga-state
    then:
      properties:
        pga-gpios: false
    else:
      required:
        - pga-gpios
  - if:
      required:
        - adi,clksel-state
    then:
      properties:
        clksel-gpios: false
    else:
      required:
        - clksel-gpios

unevaluatedProperties: false

examples:
  - |
    #include <dt-bindings/gpio/gpio.h>
    #include <dt-bindings/interrupt-controller/irq.h>

    spi {
        #address-cells = <1>;
        #size-cells = <0>;

        adc@0 {
            compatible = "adi,ad7191";
            reg = <0>;
            spi-max-frequency = <1000000>;
            spi-cpol;
            spi-cpha;
            clocks = <&ad7191_mclk>;
            interrupts = <25 IRQ_TYPE_EDGE_FALLING>;
            interrupt-parent = <&gpio>;
            avdd-supply = <&avdd>;
            dvdd-supply = <&dvdd>;
            vref-supply = <&vref>;
            odr-gpios = <&gpio 23 GPIO_ACTIVE_HIGH>, <&gpio 24 GPIO_ACTIVE_HIGH>;
            pga-gpios = <&gpio 5 GPIO_ACTIVE_HIGH>, <&gpio 6 GPIO_ACTIVE_HIGH>;
            temp-gpios = <&gpio 22 GPIO_ACTIVE_HIGH>;
            chan-gpios = <&gpio 27 GPIO_ACTIVE_HIGH>;
            clksel-gpios = <&gpio 13 GPIO_ACTIVE_HIGH>;
        };
    };
```
